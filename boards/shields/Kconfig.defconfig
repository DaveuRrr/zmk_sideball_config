## config/boards/shields/sideball/Kconfig.defconfig
```kconfig
if SHIELD_SIDEBALL

config ZMK_KEYBOARD_NAME
    default "sideball"

config SPI
	default y
endif
```

## config/west.yml
```yaml
manifest:
  remotes:
    - name: zmkfirmware
      url-base: https://github.com/zmkfirmware
    - name: badjeff
      url-base: https://github.com/badjeff
    - name: caksoylar
      url-base: https://github.com/caksoylar
    #  url-base: https://github.com/petejohanson
    #- name: sadekbaroudi
    #  url-base: https://github.com/sadekbaroudi
  projects:
    - name: zmk
      remote: zmkfirmware
      revision: main
      import: app/west.yml
    - name: zmk-pmw3610-driver
      remote: badjeff
      revision: main
    - name: zmk-rgbled-widget
      remote: caksoylar
      revision: main
    #  revision: feat/pointers-with-input-processors # feat/pointers-move-scroll
    #  import: app/west.yml
    #- name: zmk-pmw3610-driver
    #  remote: sadekbaroudi
    #  revision: main
  self:
    path: config
```
